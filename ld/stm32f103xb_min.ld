/* STM32F103xB, 128kB FLASH, 20kB SRAM */

USER_HEAP_SIZE = 8K;
USER_STACK_SIZE = 1K;
MEMORY
{
    FLASH (rx) : ORIGIN = 0x08000000, LENGTH = 128K 
    SRAM (rw)  : ORIGIN = 0x20000000, LENGTH = 20K 
}

INCLUDE default.ld
