/* STM32L152xB:    128KB FLASH, 16KB SRAM, 4KB EEPROM
 * STM32L152xB-A:  128KB FLASH, 32KB SRAM, 4KB EEPROM
 */

USER_HEAP_SIZE = 4K;
USER_STACK_SIZE = 1K;
MEMORY
{
    FLASH (rx)  : ORIGIN = 0x08000000, LENGTH = 64K 
    SRAM (rw)   : ORIGIN = 0x20000000, LENGTH = 20K 
    EEPROM (rw) : ORIGIN = 0x08080000, LENGTH = 4K
}

INCLUDE default.ld
