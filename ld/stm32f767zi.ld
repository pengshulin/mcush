/* STM32F767ZI, 2048kB FLASH, 512kB SRAM */

USER_HEAP_SIZE = 10K;
USER_STACK_SIZE = 1K;
MEMORY
{
    FLASH (rx) : ORIGIN = 0x08000000, LENGTH = 2048K
    SRAM (rw)  : ORIGIN = 0x20000000, LENGTH = 512K 
}

INCLUDE default.ld
