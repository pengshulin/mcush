/* STM32F401xE, 512kB FLASH, 96kB SRAM */

USER_HEAP_SIZE = 1K;
USER_STACK_SIZE = 1K;
MEMORY
{
    FLASH (rx)   : ORIGIN = 0x08000000, LENGTH = 512K
    SRAM (rw)    : ORIGIN = 0x20000000, LENGTH = 96K 
}

INCLUDE default.ld


