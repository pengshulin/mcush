/* STM32F103xB, 128kB FLASH, 20kB SRAM */

USER_HEAP_SIZE = 512;
USER_STACK_SIZE = 512;
MEMORY
{
    FLASH (rx) : ORIGIN = 0x08000000, LENGTH = 128K 
    SRAM (rw)  : ORIGIN = 0x20000000, LENGTH = 20K 
}

INCLUDE default.ld
