/* STM32F103xC, 256kB FLASH, 48kB SRAM */

USER_HEAP_SIZE = 16K;
USER_STACK_SIZE = 1K;
MEMORY
{
    FLASH (rx) : ORIGIN = 0x08000000, LENGTH = 256K 
    SRAM (rw)  : ORIGIN = 0x20000000, LENGTH = 48K 
}

INCLUDE default.ld
