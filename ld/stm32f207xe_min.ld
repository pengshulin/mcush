/* STM32F207xE, 512kB FLASH, 128kB SRAM */

USER_HEAP_SIZE = 40K;
USER_STACK_SIZE = 1K;
MEMORY
{
    FLASH (rx) : ORIGIN = 0x08000000, LENGTH = 512K
    SRAM (rw)  : ORIGIN = 0x20000000, LENGTH = 128K 
}

INCLUDE default.ld
