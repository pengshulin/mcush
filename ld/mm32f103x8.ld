/* MindMotion MM32F103x8, 64k FLASH, 20kB SRAM */

USER_HEAP_SIZE = 4;
USER_STACK_SIZE = 256;
MEMORY
{
    FLASH (rx) : ORIGIN = 0x08000000, LENGTH = 64K 
    SRAM (rw)  : ORIGIN = 0x20000000, LENGTH = 20K 
}

INCLUDE default.ld

