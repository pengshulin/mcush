/* REDBULL dev board */
/* STM32F103ZE, 512kB FLASH, 64kB SRAM, 512kB ESRAM, 2MB EFLASH */

USER_HEAP_SIZE = 40K;
USER_STACK_SIZE = 1K;
MEMORY
{
    FLASH (rx)  : ORIGIN = 0x08000000, LENGTH = 512K
    EFLASH (rx) : ORIGIN = 0x64000000, LENGTH = 2M
    SRAM (rw)   : ORIGIN = 0x20000000, LENGTH = 64K
    /*ESRAM (rw)  : ORIGIN = 0x68000000, LENGTH = 512K */
    /*SRAM (rw)  : ORIGIN = 0x68000000, LENGTH = 512K */
}

INCLUDE default.ld
