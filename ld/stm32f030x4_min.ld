/* STM32F030x4, 16k FLASH, 4kB SRAM */

USER_HEAP_SIZE = 0K;
USER_STACK_SIZE = 512;
MEMORY
{
    FLASH (rx) : ORIGIN = 0x08000000, LENGTH = 16K 
    SRAM (rw)  : ORIGIN = 0x20000000, LENGTH = 4K 
}

INCLUDE default.ld

